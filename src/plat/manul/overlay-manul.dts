/* SPDX-License-Identifier: GPL-2.0-only */
/ {
    chosen {
        /* SBI console/timer; map CLINT for optional direct mtime reads. */
        seL4,kernel-devices = &{/soc/timer@2000000},
                             &{/soc/interrupt-controller@c000000};
    };
    reserved-memory {
        #address-cells = <2>;
        #size-cells = <2>;
        ranges;
        sbi@80000000 {
            reg = <0 0x80000000 0 0x200000>;
            no-map;
        };
    };
};
